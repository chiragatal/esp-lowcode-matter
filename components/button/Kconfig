## components/button/Kconfig
```kconfig
menu "BUTTON"
    choice BUTTON_DRIVER_GPIO_SETTINGS
        prompt "Select HP/LP gpio as button input"
        default BUTTON_DRIVER_USE_HP_GPIO

        config BUTTON_DRIVER_USE_HP_GPIO
        bool "Select HP GPIO as button input"

        config HP_BUTTON_LOOP_INTERVAL
        depends on BUTTON_DRIVER_USE_HP_GPIO
        int "Interval between HP GPIO timer in ms"
        default 50

        config BUTTON_DRIVER_USE_LP_GPIO
        bool "Select LP GPIO as button input"
    endchoice

    config MAX_BUTTON_NUM
    int "Maximum number of buttons"
    default 4
endmenu
```

## components/light/Kconfig
```kconfig
menu "Light"
    choice LIGHT_DEVICE_TYPE
        prompt "Select light device type"
        default USE_LIGHT_DEVICE_TYPE_WS2812

        config USE_LIGHT_DEVICE_TYPE_WS2812
        bool "Select WS2812 as light device"

        config USE_LIGHT_DEVICE_TYPE_LED
        bool "Select LED as light device"
    endchoice
endmenu
```

## products/common/sdkconfig.defaults
```kconfig
# Enable LP Core
CONFIG_ULP_PANIC_OUTPUT_ENABLE=y
CONFIG_ULP_COPROC_ENABLED=y
CONFIG_ULP_COPROC_TYPE_LP_CORE=y
CONFIG_ULP_HP_UART_CONSOLE_PRINT=y

# AMP
CONFIG_ESP_AMP_ENABLED=y
CONFIG_ESP_AMP_SUBCORE_TYPE_LP_CORE=y
CONFIG_ESP_AMP_SYSTEM_ENABLE_SUPPLICANT=y
CONFIG_ESP_AMP_ROUTE_SUBCORE_PRINT=y
CONFIG_ESP_AMP_SHARED_MEM_SIZE=20480

# LP Core Memory
CONFIG_ULP_COPROC_RESERVE_MEM=14500
CONFIG_ESPTOOLPY_FLASHSIZE_4MB=y

# HP Core Memory
CONFIG_ESP_AMP_SUBCORE_USE_HP_MEM=y
CONFIG_ESP_AMP_SUBCORE_USE_HP_MEM_SIZE=49152

# Memory Optimisation
CONFIG_COMPILER_OPTIMIZATION_SIZE=y

CONFIG_OPTIMIZATION_ASSERTIONS_SILENT=y
# CONFIG_ULP_HP_UART_CONSOLE_PRINT=n
```
